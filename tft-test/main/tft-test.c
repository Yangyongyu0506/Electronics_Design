#include <assert.h>
#include <stdio.h>
#include <string.h>

#include "esp_log.h"
#include "esp_lcd_panel_io.h"
#include "driver/gpio.h"
#include "driver/spi_master.h"
#include "freertos/FreeRTOS.h"
#include "freertos/task.h"

static const char *TAG = "tft";

#define PIN_SCK     GPIO_NUM_21
#define PIN_SDI     GPIO_NUM_47
#define PIN_DC      GPIO_NUM_39
#define PIN_RST     GPIO_NUM_48

#define LCD_H_RES   128
#define LCD_V_RES   160
#define LCD_MADCTL  0xC0

static const uint8_t FONT5X7[95][7] = {
    {0x00,0x00,0x00,0x00,0x00,0x00,0x00}, /*  32   */
    {0x04,0x04,0x04,0x00,0x04,0x00,0x00}, /*  33 ! */
    {0x06,0x06,0x00,0x00,0x00,0x00,0x00}, /*  34 " */
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    {0x00,0x03,0x0C,0x00,0x00,0x00,0x00}, /* 126 ~ */
};

static esp_lcd_panel_io_handle_t s_io;
static uint16_t *s_fb;

static void lcd_cmd(uint8_t cmd)
{
    ESP_ERROR_CHECK(esp_lcd_panel_io_tx_param(s_io, cmd, NULL, 0));
}

static void lcd_data(const uint8_t *data, size_t len)
{
    ESP_ERROR_CHECK(esp_lcd_panel_io_tx_param(s_io, -1, data, len));
}

static void st7735_init(void)
{
    gpio_set_direction(PIN_RST, GPIO_MODE_OUTPUT);
    gpio_set_level(PIN_RST, 0);
    vTaskDelay(pdMS_TO_TICKS(20));
    gpio_set_level(PIN_RST, 1);
    vTaskDelay(pdMS_TO_TICKS(120));

    lcd_cmd(0x01);
    vTaskDelay(pdMS_TO_TICKS(150));
    lcd_cmd(0x11);
    vTaskDelay(pdMS_TO_TICKS(120));

    uint8_t d3[] = {0x01, 0x2C, 0x2D};
    lcd_cmd(0xB1); lcd_data(d3, 3);
    lcd_cmd(0xB2); lcd_data(d3, 3);
    uint8_t d6[] = {0x01, 0x2C, 0x2D, 0x01, 0x2C, 0x2D};
    lcd_cmd(0xB3); lcd_data(d6, 6);
    lcd_cmd(0xB4); lcd_data((const uint8_t[]){0x07}, 1);
    uint8_t p1[] = {0xA2, 0x02, 0x84};
    lcd_cmd(0xC0); lcd_data(p1, 3);
    lcd_cmd(0xC1); lcd_data((const uint8_t[]){0xC5}, 1);
    lcd_cmd(0xC2); lcd_data((const uint8_t[]){0x0A, 0x00}, 2);
    lcd_cmd(0xC3); lcd_data((const uint8_t[]){0x8A, 0x2A}, 2);
    lcd_cmd(0xC4); lcd_data((const uint8_t[]){0x8A, 0xEE}, 2);
    lcd_cmd(0xC5); lcd_data((const uint8_t[]){0x0E}, 1);
    lcd_cmd(0x20);

    lcd_cmd(0x36); lcd_data((const uint8_t[]){LCD_MADCTL}, 1);
    lcd_cmd(0x3A); lcd_data((const uint8_t[]){0x05}, 1);

    static const uint8_t gamma_p[] = {
        0x02, 0x1C, 0x07, 0x12, 0x37, 0x32, 0x29, 0x2D,
        0x29, 0x25, 0x2B, 0x39, 0x00, 0x01, 0x03, 0x10,
    };
    static const uint8_t gamma_n[] = {
        0x03, 0x1D, 0x07, 0x06, 0x2E, 0x2C, 0x29, 0x2D,
        0x2E, 0x2E, 0x37, 0x3F, 0x00, 0x00, 0x02, 0x10,
    };
    lcd_cmd(0xE0); lcd_data(gamma_p, 16);
    lcd_cmd(0xE1); lcd_data(gamma_n, 16);

    lcd_cmd(0x13);
    vTaskDelay(pdMS_TO_TICKS(10));
    lcd_cmd(0x29);
    vTaskDelay(pdMS_TO_TICKS(100));
    ESP_LOGI(TAG, "ST7735 init done");
}

static void st7735_flush(const uint16_t *fb)
{
    uint8_t x[] = {0x00, 0x00, 0x00, LCD_H_RES - 1};
    uint8_t y[] = {0x00, 0x00, 0x00, LCD_V_RES - 1};
    lcd_cmd(0x2A); lcd_data(x, 4);
    lcd_cmd(0x2B); lcd_data(y, 4);
    lcd_cmd(0x2C);
    ESP_ERROR_CHECK(esp_lcd_panel_io_tx_color(s_io, -1, fb, LCD_H_RES * LCD_V_RES * 2));
}

static void fb_fill(uint16_t color)
{
    for (uint32_t i = 0; i < LCD_H_RES * LCD_V_RES; i++) {
        s_fb[i] = color;
    }
}

static void draw_char(int x, int y, char c, uint16_t color)
{
    if (c < 32 || c > 126) {
        c = '?';
    }
    const uint8_t *glyph = FONT5X7[c - 32];
    for (int row = 0; row < 7; row++) {
        for (int col = 0; col < 5; col++) {
            if ((glyph[row] >> col) & 1) {
                int px = x + col;
                int py = y + row;
                if (px >= 0 && px < LCD_H_RES && py >= 0 && py < LCD_V_RES) {
                    s_fb[(size_t)py * LCD_H_RES + px] = color;
                }
            }
        }
    }
}

static void draw_text(int x, int y, const char *str, uint16_t color)
{
    while (*str) {
        draw_char(x, y, *str, color);
        x += 6;
        str++;
    }
}

void app_main(void)
{
    spi_bus_config_t buscfg = {
        .sclk_io_num = PIN_SCK,
        .mosi_io_num = PIN_SDI,
        .miso_io_num = -1,
        .quadwp_io_num = -1,
        .quadhd_io_num = -1,
        .max_transfer_sz = LCD_H_RES * LCD_V_RES * 2,
    };
    ESP_ERROR_CHECK(spi_bus_initialize(SPI2_HOST, &buscfg, SPI_DMA_CH_AUTO));

    esp_lcd_panel_io_spi_config_t io_config = {
        .dc_gpio_num = PIN_DC,
        .cs_gpio_num = -1,
        .pclk_hz = 10 * 1000 * 1000,
        .lcd_cmd_bits = 8,
        .lcd_param_bits = 8,
        .spi_mode = 0,
        .trans_queue_depth = 10,
    };
    ESP_ERROR_CHECK(esp_lcd_new_panel_io_spi((esp_lcd_spi_bus_handle_t)SPI2_HOST, &io_config, &s_io));

    st7735_init();

    s_fb = heap_caps_malloc(LCD_H_RES * LCD_V_RES * 2, MALLOC_CAP_INTERNAL | MALLOC_CAP_8BIT);
    assert(s_fb != NULL);
    ESP_LOGI(TAG, "framebuffer ready: %u bytes", (unsigned)(LCD_H_RES * LCD_V_RES * 2));

    fb_fill(0xF800);
    st7735_flush(s_fb);
    ESP_LOGI(TAG, "sanity check: solid RED, check the panel");
    vTaskDelay(pdMS_TO_TICKS(1000));

    uint32_t tick = 0;
    while (1) {
        fb_fill(0x0000);
        draw_text(6, 10, "TFT TEST", 0xFFFF);
        draw_text(6, 26, "ESP32-S3", 0x07E0);
        char line[32];
        snprintf(line, sizeof(line), "tick: %lu", (unsigned long)tick);
        draw_text(6, 48, line, 0x001F);
        draw_text(6, 64, "Hello World!", 0xF800);
        draw_text(6, 88, "ABCDEFGHIJKLM", 0xFFE0);
        draw_text(6, 96, "NOPQRSTUVWXYZ", 0xFFE0);
        draw_text(6, 104, "0123456789", 0xFFE0);
        draw_text(6, 112, "abcdefghijklm", 0xF81F);
        draw_text(6, 120, "nopqrstuvwxyz", 0xF81F);
        draw_text(6, 136, "!\"#$%&'()*+,-./", 0xFFFF);
        draw_text(6, 144, ":;<=>?@[]^_`{|}~", 0xFFFF);

        st7735_flush(s_fb);
        tick++;
        vTaskDelay(pdMS_TO_TICKS(1000));
    }
}
