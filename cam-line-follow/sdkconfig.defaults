## camera-test/sdkconfig.defaults
```kconfig
CONFIG_ESPTOOLPY_FLASHSIZE_2MB=y

CONFIG_USB_HOST_CONTROL_TRANSFER_MAX_SIZE=16384
CONFIG_USB_HOST_HW_BUFFER_BIAS_IN=y

CONFIG_ESP_WIFI_STATIC_RX_BUFFER_NUM=8
CONFIG_ESP_WIFI_DYNAMIC_RX_BUFFER_NUM=8
CONFIG_ESP_WIFI_STATIC_TX_BUFFER_NUM=8
CONFIG_ESP_WIFI_CACHE_TX_BUFFER_NUM=16
CONFIG_ESP_WIFI_RX_BA_WIN=8

CONFIG_LWIP_TCP_SND_BUF_DEFAULT=15000
```
